/*
 * MYZR Technology Co.,Ltd
 * http://www.myzr.com.cn
 * Tang Bin <tangb@myzr.com.cn>
 */

#include "myimx6ek140-6g.dts"

/ {
	model = "MY-IMX6-EK140 (i.MX6UL, eMMC, 140 Pins) Board (Mem: 512MB)";
};
