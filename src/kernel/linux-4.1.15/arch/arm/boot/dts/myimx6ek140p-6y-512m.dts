/*
 * MYZR Technology Co.,Ltd
 * http://www.myzr.com.cn
 * Tang Bin <tangb@myzr.com.cn>
 */

#include "myimx6ek140p-6y.dts"

/ {
	model = "MY-IMX6-EK140P (i.MX6ULL, 140 Pins, Plus) Board (Mem: 512MB)";
};
